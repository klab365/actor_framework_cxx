## CMakeLists.txt
```
cmake_minimum_required(VERSION 3.20.0)

# Let this example build directly from the repository checkout:
#   west build -b native_sim examples/basic_zephyr
# If the module is already provided by a west workspace, this extra entry is
# harmless; Zephyr de-duplicates modules by name.
list(APPEND ZEPHYR_EXTRA_MODULES "${CMAKE_CURRENT_LIST_DIR}/../..")

# Ask Zephyr/binutils to print linker memory-region usage after the build.
# Keep this in CMake so the example always reports flash/ROM usage without
# requiring users to remember an extra `west build -t rom_report` command.
set(IPC_FLASH_USAGE_CONF "${CMAKE_CURRENT_BINARY_DIR}/ipc_flash_usage.conf")
file(WRITE "${IPC_FLASH_USAGE_CONF}" "CONFIG_OUTPUT_PRINT_MEMORY_USAGE=y\n")
list(APPEND EXTRA_CONF_FILE "${IPC_FLASH_USAGE_CONF}")

find_package(Zephyr REQUIRED HINTS $ENV{ZEPHYR_BASE})
project(ipc_basic_zephyr C)

target_sources(app PRIVATE src/main.c)

# Print a compact ELF size summary as part of the normal build. In the output,
# flash/ROM usage is approximately `text + data`; RAM usage is `data + bss`.
find_program(IPC_SIZE_TOOL NAMES ${CROSS_COMPILE}size size)
if(IPC_SIZE_TOOL AND TARGET zephyr_pre0)
  add_custom_target(
    ipc_basic_size_summary ALL
    COMMAND ${CMAKE_COMMAND} -E echo "IPC basic Zephyr size summary (flash ~= text + data):"
    COMMAND ${IPC_SIZE_TOOL} $<TARGET_FILE:zephyr_pre0>
    DEPENDS zephyr_pre0
    VERBATIM)
endif()
```

## west.yml
```
manifest:
  remotes:
    - name: zephyrproject-rtos
      url-base: https://github.com/zephyrproject-rtos

  projects:
    - name: zephyr
      remote: zephyrproject-rtos
      revision: v3.7.0

      # Still load Zephyr's west extension commands, including `west build`.
      west-commands: scripts/west-commands.yml

  self:
    path: basic_zephyr
```

## prj.conf
```kconfig
CONFIG_ACTOR=y
```

## src/main.c
```c
#include <errno.h>
#include <ipc.h>
#include <stdatomic.h>
#include <stdlib.h>
#include <zephyr/init.h>
#include <zephyr/kernel.h>
#include <zephyr/sys/printk.h>

IPC_CMD_DEFINE_LOCAL(BasicPing, { uint32_t count; });
IPC_CMD_DEFINE_LOCAL(BasicPong, { uint32_t count; });
IPC_CMD_DEFINE_LOCAL(BasicFault, { uint32_t code; });
IPC_CMD_DEFINE_LOCAL(BasicStatusRequest, { uint32_t request_id; });
IPC_CMD_REPLY_DEFINE_LOCAL(BasicStatusRequest, BasicStatusResponse, {
    uint32_t request_id;
    uint32_t ping_count;
    uint32_t pong_count;
});

static atomic_uint basic_ping_count;
static atomic_uint basic_pong_count;
static bool pong_restart_pending;
static unsigned int pong_restart_count;

/* Each actor declares exact-size static stack/msgq storage via ipc.h. */
IPC_ACTOR_DEFINE(ping_actor, "ipc_ping", 1024, K_PRIO_PREEMPT(7), 4,
                 IPC_MESSAGE_MAX(BasicPong, BasicStatusResponse));
IPC_ACTOR_DEFINE(pong_actor, "ipc_pong", 2048, K_PRIO_PREEMPT(7), 4,
                 IPC_MESSAGE_MAX(BasicPing, BasicStatusRequest, BasicFault));
IPC_SUPERVISE(pong_actor, IPC_SUPERVISE_RESTART);

IPC_START_HOOK(ping_actor, ping_on_start)
{
    ARG_UNUSED(self);
    printk("ipc basic: ping start hook\n");
}

IPC_STOP_HOOK(ping_actor, ping_on_stop)
{
    ARG_UNUSED(self);
    printk("ipc basic: ping stop hook\n");
}

IPC_UNKNOWN(ping_actor, ping_on_unknown)
{
    ARG_UNUSED(self);
    printk("ipc basic: ping unknown id=0x%x kind=%d\n", msg->id, (int) msg->kind);
}

IPC_START_HOOK(pong_actor, pong_on_start)
{
    ARG_UNUSED(self);
    if (pong_restart_pending) {
        pong_restart_pending = false;
        printk("ipc basic: pong RESTART complete (#%u)\n", pong_restart_count);
    } else {
        printk("ipc basic: pong initial start hook\n");
    }
}

IPC_STOP_HOOK(pong_actor, pong_on_stop)
{
    ARG_UNUSED(self);
    if (pong_restart_pending) {
        printk("ipc basic: pong stop hook before restart #%u\n", pong_restart_count);
    } else {
        printk("ipc basic: pong stop hook\n");
    }
}

IPC_UNKNOWN(pong_actor, pong_on_unknown)
{
    ARG_UNUSED(self);
    printk("ipc basic: pong unknown id=0x%x kind=%d\n", msg->id, (int) msg->kind);
}

IPC_FAIL_HOOK(pong_actor, pong_on_failure)
{
    ARG_UNUSED(self);
    pong_restart_count++;
    pong_restart_pending = true;
    printk("ipc basic: pong failure reason=%d -> restart #%u\n", reason, pong_restart_count);
}

IPC_ACTOR_HANDLE(pong_actor, BasicPing, on_basic_ping)
{
    ARG_UNUSED(self);

    atomic_fetch_add_explicit(&basic_ping_count, 1U, memory_order_relaxed);
    printk("ipc basic: ping %u\n", msg->count);

    BasicPong_payload_t payload = {.count = msg->count};
    int rc                      = ipc_send(BasicPong, payload);
    if (rc != 0) {
        printk("ipc basic: pong send failed: %d\n", rc);
    }
}

IPC_ACTOR_HANDLE(ping_actor, BasicPong, on_basic_pong)
{
    (void) self;
    (void) raw_msg;

    atomic_fetch_add_explicit(&basic_pong_count, 1U, memory_order_relaxed);
    printk("ipc basic: pong %u\n", msg->count);

    if (msg->count < 5U) {
        BasicPing_payload_t payload = {.count = msg->count + 1U};
        int rc                      = ipc_send_after(BasicPing, 1000U, payload);
        if (rc != 0) {
            printk("ipc basic: next ping schedule failed: %d\n", rc);
        }
    }
}

IPC_ACTOR_HANDLE(pong_actor, BasicStatusRequest, on_basic_status_request)
{
    (void) self;

    if (msg->request_id == 0U) {
        int rc = ipc_reply_error(raw_msg, -EINVAL);
        if (rc != 0) {
            printk("ipc basic: status error reply failed: %d\n", rc);
        }
        return;
    }

    BasicStatusResponse_payload_t response = {
        .request_id = msg->request_id,
        .ping_count = atomic_load_explicit(&basic_ping_count, memory_order_relaxed),
        .pong_count = atomic_load_explicit(&basic_pong_count, memory_order_relaxed),
    };
    printk("ipc basic: status request %u -> ping=%u pong=%u\n", response.request_id,
           response.ping_count, response.pong_count);
    int rc = ipc_reply(raw_msg, BasicStatusResponse, response);
    if (rc != 0) {
        printk("ipc basic: status reply failed: %d\n", rc);
    }
}

IPC_ACTOR_HANDLE(pong_actor, BasicFault, on_basic_fault)
{
    (void) raw_msg;

    printk("ipc basic: pong received fault code=0x%x; reporting actor failure\n", msg->code);
    int rc = ipc_actor_fail(self, -EIO);
    if (rc != 0) {
        printk("ipc basic: pong supervision failed: %d\n", rc);
    }
}

IPC_ACTOR_RESPONSE_HANDLE(ping_actor, BasicStatusRequest, BasicStatusResponse,
                          on_basic_status_response)
{
    (void) self;
    (void) raw_msg;
    if (result != 0) {
        printk("ipc basic: status ask failed: %d\n", result);
        return;
    }

    printk("ipc basic: status response request=%u ping=%u pong=%u\n", msg->request_id,
           msg->ping_count, msg->pong_count);
}

static int basic_actor_init(void)
{
    int rc = ipc_start_all_actors();
    if (rc != 0) {
        printk("ipc basic: actor start failed: %d\n", rc);
        return rc;
    }

    BasicPing_payload_t payload = {.count = 1U};
    rc                          = ipc_send(BasicPing, payload);
    if (rc != 0) {
        printk("ipc basic: initial ping send failed: %d\n", rc);
        return rc;
    }

    return 0;
}

SYS_INIT(basic_actor_init, APPLICATION, 85);

int main(void)
{
    printk("IPC Actor Framework basic Zephyr example\n");

    /* The actors exchange ping/pong once per second until ping 5. Ask the
     * pong actor for status via async request/response before stopping the
     * actor threads so native_sim can terminate cleanly.
     */
    k_sleep(K_SECONDS(6));

    BasicStatusRequest_payload_t request = {.request_id = 1U};
    uint32_t ask_id                      = 0;
    int rc = ipc_ask_with_id(&ping_actor, BasicStatusRequest, request, on_basic_status_response,
                             &ask_id, 1000);
    if (rc != 0) {
        printk("ipc basic: status ask failed: %d\n", rc);
    } else {
        printk("ipc basic: status ask queued (id=%u)\n", ask_id);
    }

    /* request_id 0 demonstrates ipc_reply_error(): the response callback
     * receives result == -EINVAL and does not read msg. */
    BasicStatusRequest_payload_t invalid_request = {.request_id = 0U};
    rc = ipc_ask_with(&ping_actor, BasicStatusRequest, invalid_request, on_basic_status_response,
                      1000);
    if (rc != 0) {
        printk("ipc basic: invalid status ask failed to queue: %d\n", rc);
    }
    k_sleep(K_MSEC(100));

    /* This delayed ping belongs to pong_actor. The fault below restarts that
     * actor, so its pending delayed work must be cancelled before it fires. */
    BasicPing_payload_t cancelled_ping = {.count = 99U};
    rc                                 = ipc_send_after(BasicPing, 1000U, cancelled_ping);
    if (rc != 0) {
        printk("ipc basic: delayed ping schedule failed: %d\n", rc);
    }

    BasicFault_payload_t fault = {.code = 0xBADCAFEu};
    rc                         = ipc_send(BasicFault, fault);
    if (rc != 0) {
        printk("ipc basic: fault send failed: %d\n", rc);
    }
    k_sleep(K_MSEC(1200));

    ipc_stop_all();
    printk("zephyr-basic OK\n");

    /* native_sim keeps the Zephyr kernel/idle thread alive after main()
     * returns. Use the host exit path so `west build -t run` terminates.
     */
    exit(0);
}
```
